VERSION ""

NS_ :

BS_:

BU_:
VAL_TABLE_ VT_EngineStatus 1 "Engine Running" 0 "Engine not running" ;
VAL_TABLE_ VT_BrakeStatus 1 "Brake applied" 0 "Brake not applied" ;

BO_ 263 RPMMsg: 2 Vector__XXX
 SG_ RPMStatus : 0|16@1+ (0.1,0) [0|65535] "rpm" Vector__XXX

BO_ 260 VehicleMotion: 4 Vector__XXX
 SG_ Velocity : 16|16@1+ (0.1,0) [0|65535] "km/hr" Vector__XXX
 SG_ EngineRunning : 0|1@1+ (1,0) [0|1] "Boolean" Vector__XXX

BO_ 261 BrakeMsg: 1 Vector__XXX
 SG_ BrakeStatus : 0|1@1+ (1,0) [0|1] "Boolean" Vector__XXX

BO_ 262 AccelerationMsg: 2 Vector__XXX
 SG_ Acceleration : 0|16@1+ (0.1,0) [0|65535] "m/s^2" Vector__XXX

EV_ Piston: 0 [0|15] "" 0 1 DUMMY_NODE_VECTOR0 Vector__XXX;

EV_ Acceleration_Env: 0 [0|2210] "m/s^2" 0 2 DUMMY_NODE_VECTOR0 Vector__XXX;

VAL_ 260 EngineRunning 1 "Engine Running" 0 "Engine not running" ;
VAL_ 261 BrakeStatus 1 "Brake applied" 0 "Brake not applied" ;
