VERSION ""

NS_ :

BS_:

BU_:
VAL_TABLE_ VT_Sunroof 1 "There is Obstacle" 0 "No Obstacle" ;

BO_ 561 ObstacleMsg: 8 Vector__XXX
 SG_ ObstacleStatus : 0|1@1+ (1,0) [0|1] "" Vector__XXX

BO_ 563 SunroofMsg: 8 Vector__XXX
 SG_ SunroofStatus : 0|16@1+ (0.1,0) [0|65535] "" Vector__XXX

BO_ 562 WiperMsg: 2 Vector__XXX
 SG_ WiperStatus : 0|16@1+ (1,0) [0|65535] "" Vector__XXX

EV_ SunroofI: 0 [0|15] "" 0 1 DUMMY_NODE_VECTOR0 Vector__XXX;

VAL_ 561 ObstacleStatus 1 "There is Obstacle" 0 "No Obstacle" ;
