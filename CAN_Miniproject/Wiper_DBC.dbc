VERSION ""

NS_ :

BS_:

BU_:

BO_ 562 WiperMsg: 1 Vector__XXX
 SG_ WiperStatus : 0|16@1+ (0.1,0) [0|65535] "" Vector__XXX
